## CMakeLists.txt
```
# Freestanding Zephyr application: ZEPHYR_BASE must point at the Zephyr repo
# inside ~/zephyrproject.

cmake_minimum_required(VERSION 3.20.0)

# `west debug` / `west attach` fix. With CONFIG_DEBUG_THREAD_INFO=y the OpenOCD
# runner appends `$_TARGETNAME configure -rtos Zephyr` for thread-aware
# debugging, but RP2040's upstream `target/rp2040.cfg` names its core target
# `_TARGETNAME_0` (it's a dual-core part) and never defines the singular
# `_TARGETNAME` the runner assumes. The undefined Tcl variable aborts OpenOCD
# init, so the GDB server never comes up and `west debug` dies with a
# connection timeout. Point the runner at the real handle. (`west flash` is
# unaffected -- it doesn't emit the RTOS command.)
#
# `board_finalize_runner_args` invokes this macro, but only if it's defined
# before find_package(Zephyr) -- the finalize runs while the board is processed,
# which find_package triggers -- so it must sit above that line, not below.
#
# The macro fires once per runner the board registers (rpi_pico has six), so a
# GLOBAL-property guard keeps it from appending the same arg six times.
macro(app_set_runner_args)
  get_property(_app_runner_args_done GLOBAL PROPERTY app_runner_args_done)
  if(NOT _app_runner_args_done)
    set_property(GLOBAL PROPERTY app_runner_args_done TRUE)
    board_runner_args(openocd "--target-handle=_TARGETNAME_0")
  endif()
endmacro()

find_package(Zephyr REQUIRED HINTS $ENV{ZEPHYR_BASE})
project(rpi_pico_zephyr_debug)

target_sources(app PRIVATE
  src/main.cpp
  src/temp_convert.cpp
)
```

## prj.conf
```kconfig
# --- language ----------------------------------------------------------------
# This port is C++ -- the counterpart to the Rust sibling next door, and to the
# C micro:bit app. CONFIG_CPP turns on the C++ support library; STD_CPP20 pins
# the standard to match the repo's other C++ (the Bazel ports build -std=c++20).
CONFIG_CPP=y
CONFIG_STD_CPP20=y

# --- logging + console -------------------------------------------------------
# Logs go to uart0 (GP0 = TX, GP1 = RX), which the board also chooses for the
# shell. With a Raspberry Pi Debug Probe, wire the probe's UART port to GP0/GP1
# to read them at 115200. See README.md.
CONFIG_LOG=y
CONFIG_MAIN_STACK_SIZE=2048

# --- on-device shell ---------------------------------------------------------
# A live introspection path beside the external debugger: `kernel threads`,
# `kernel stacks`, `log enable dbg <module>`, and this app's own `temp` command.
CONFIG_SHELL=y
CONFIG_KERNEL_SHELL=y
# Deferred logging moves formatting off the calling thread and keeps log records
# from shredding a half-typed command line.
CONFIG_LOG_MODE_DEFERRED=y
# `log enable dbg <module>` at runtime -- the point of the per-module
# LOG_MODULE_REGISTER call.
CONFIG_LOG_CMDS=y
# `kernel stacks` reports stack high-water marks, which INIT_STACKS provides.
# The thread names and registry `kernel threads` needs come from
# CONFIG_DEBUG_THREAD_INFO below (it selects THREAD_NAME and THREAD_MONITOR), so
# they are not repeated here.
CONFIG_INIT_STACKS=y
# Opt-in for clean core-dump captures. The shell colors `<err>` log lines, and
# the trailing reset escape (`\x1b[0m`) glued onto each `#CD:` line is what makes
# coredump_serial_log_parser.py choke -- so a raw capture needs the sed strip in
# README.md's exercise 7. Uncomment to drop log colors at the source instead;
# then a plain `cat | tee` capture parses untouched. The only cost is no color
# in the live console. (Leave it commented to keep color for the other
# exercises and strip on capture; see README.md.)
# CONFIG_LOG_BACKEND_SHOW_COLOR=n

# --- heartbeat LED -----------------------------------------------------------
# Drives the optional external LED declared under `zephyr,user` in app.overlay.
CONFIG_GPIO=y

# --- debuggability -----------------------------------------------------------
# The whole point of this project.
#
# DEBUG_OPTIMIZATIONS builds at -Og with frame pointers, so breakpoints land on
# the source line you asked for and backtraces read cleanly. At the default -O2
# the loop is reordered and inlined past recognition.
CONFIG_DEBUG=y
CONFIG_DEBUG_OPTIMIZATIONS=y
# Exports kernel struct offsets so OpenOCD/GDB can enumerate Zephyr threads
# (thread-aware `info threads` and backtraces). Selects THREAD_MONITOR/NAME.
CONFIG_DEBUG_THREAD_INFO=y
# Turns the deliberate out-of-bounds write into a deterministic fatal error
# instead of silent corruption -- see the __ASSERT in src/main.cpp.
CONFIG_ASSERT=y
# Collect register/fault state and walk the stack on a fatal error, so the
# assert prints a symbolic backtrace. EXTRA_EXCEPTION_INFO is what enables
# arch_stack_walk() on Cortex-M (it gates ARCH_HAS_STACKWALK); EXCEPTION_STACK_TRACE
# then defaults on and does the printing.
CONFIG_EXTRA_EXCEPTION_INFO=y
CONFIG_EXCEPTION_STACK_TRACE=y
# Post-mortem debugging: on a fatal error, dump CPU registers and memory so the
# crash can be replayed in GDB later, without a live probe session. The LOGGING
# backend streams the dump over the same console the log uses (as `#CD:` lines),
# so no flash partition or extra hardware is needed; it works despite
# LOG_MODE_DEFERRED because the fatal path switches logging into panic (sync)
# mode. MEMORY_DUMP_LINKER_RAM dumps all RAM -- larger/slower over serial than
# the default MEMORY_DUMP_MIN (registers + faulting stack), but it's what lets
# you inspect globals like `history` / `sample_index` in the replay. See
# README.md, "Post-mortem: capture and replay a core dump".
CONFIG_DEBUG_COREDUMP=y
CONFIG_DEBUG_COREDUMP_BACKEND_LOGGING=y
CONFIG_DEBUG_COREDUMP_MEMORY_DUMP_LINKER_RAM=y
```

## app.overlay
```dts
/*
 * The Pico W's onboard LED is behind the CYW43 wireless chip, not a plain
 * GPIO, so the heartbeat uses an EXTERNAL LED wired to a free pin. GP15
 * (physical pin 20) is convenient -- clear of the SWD link and of the
 * UART-console pins GP0/GP1.
 *
 * It's declared under `zephyr,user` and picked up with GPIO_DT_SPEC_GET_OR in
 * src/main.cpp; delete this file and the firmware just runs without the LED.
 *
 * Wire the LED anode to GP15 through a ~330 ohm resistor and the cathode to GND.
 */

/ {
	zephyr,user {
		led-gpios = <&gpio0 15 GPIO_ACTIVE_HIGH>;
	};
};
```

## src/main.cpp
```c
/*
 * A minimal RP2040 (Raspberry Pi Pico W) firmware whose only job is to be a
 * target for a debugger -- breakpoints, watchpoints, and a fatal-error
 * backtrace -- driven over SWD by a Raspberry Pi Debug Probe and OpenOCD.
 *
 * It is the C++/Zephyr counterpart of ../rpi_pico_rust_debug (Rust/embassy +
 * probe-rs). See README.md for the wiring and the debugging walkthrough.
 *
 * The heart of it is a deliberate bug: a ring-buffer index that never wraps.
 * See the loop in main() and README.md's "What to try".
 */

#include "temp_convert.hpp"

#include <zephyr/drivers/gpio.h>
#include <zephyr/kernel.h>
#include <zephyr/logging/log.h>

#ifdef CONFIG_SHELL
#include <zephyr/shell/shell.h>
#endif

LOG_MODULE_REGISTER(main, LOG_LEVEL_INF);

/* File-scope `static` rather than an anonymous namespace, deliberately: the
 * whole point of this firmware is the debugger, so `history`, `sample_index`,
 * and `sample_count` are kept at plain file scope where GDB resolves them by
 * their source names (`print sample_index`, `watch sample_count`). An anonymous
 * namespace tucks them under a `(anonymous namespace)` scope instead, which
 * some GDB versions then want qualified. (C++ still mangles the *linkage*
 * symbol either way -- `_ZL7history` -- but GDB reads the DWARF name, not that.)
 */

/* Size of the temperature-history ring buffer. Deliberately small so the bug
 * below fires within a few seconds instead of requiring a long wait.
 */
constexpr size_t HISTORY_LEN = 8;

/* One sample every 500 ms -- a slow, human-readable heartbeat. */
constexpr int SAMPLE_PERIOD_MS = 500;

static int32_t history[HISTORY_LEN];
static size_t sample_index;

/* A file-scope mirror of `sample_index`, updated after every increment. It is
 * a clean, named target for a hardware watchpoint (`watch sample_count` in
 * GDB): it lives at a fixed address in RAM and appears in the debug info by
 * name. `volatile` stops -Og from optimising the store away.
 *
 * Unlike the Rust sibling -- where the equivalent `index` is a local of an
 * async state machine that the debugger can't resolve, so the mirror is the
 * only way to watch it -- here the loop's `sample_index` is itself a plain
 * static that GDB reads directly. So this is a convenience that keeps the
 * watchpoint exercise identical across the two ports, not a necessity.
 */
static volatile uint32_t sample_count;

/* Optional heartbeat LED. On a Pico W the onboard LED hangs off the CYW43
 * wireless chip rather than a plain GPIO, so this is an EXTERNAL LED on a free
 * pin, declared under `zephyr,user` in app.overlay. If no overlay provides one
 * the spec is zero-initialised and the LED is simply skipped.
 */
static const struct gpio_dt_spec led = GPIO_DT_SPEC_GET_OR(DT_PATH(zephyr_user), led_gpios, {0});

/* A synthetic stand-in for an ADC reading. The Rust sibling samples the RP2040
 * onboard temperature sensor here; this port generates the raw 12-bit value in
 * software so the exercise is deterministic and needs no working ADC -- the
 * point is the debugger and the bug, not the sensor. It sweeps a sawtooth
 * across a plausible band around the datasheet's 27 C reference (raw ~= 876).
 */
static uint16_t next_raw()
{
	static uint16_t tick;

	tick++;
	return static_cast<uint16_t>(820 + (tick * 3) % 120);
}

#ifdef CONFIG_SHELL
/* `temp` shell command: dump the ring buffer and the two indices over the
 * console, an on-device introspection path beside the external debugger.
 */
static int cmd_temp(const struct shell *sh, size_t argc, char **argv)
{
	ARG_UNUSED(argc);
	ARG_UNUSED(argv);

	/* Snapshot the loop's shared state under a scheduler lock so the dump is
	 * internally consistent even if main() is mid-iteration -- the shell I/O
	 * then runs outside the lock, where it's free to block.
	 */
	int32_t snapshot[HISTORY_LEN];
	size_t index;
	uint32_t count;

	k_sched_lock();
	index = sample_index;
	count = sample_count;
	for (size_t i = 0; i < HISTORY_LEN; i++) {
		snapshot[i] = history[i];
	}
	k_sched_unlock();

	shell_print(sh, "sample_index=%zu sample_count=%u (HISTORY_LEN=%zu)", index, count,
		    HISTORY_LEN);
	for (size_t i = 0; i < HISTORY_LEN; i++) {
		shell_print(sh, "  history[%zu] = %d m°C", i, snapshot[i]);
	}

	return 0;
}

SHELL_CMD_REGISTER(temp, NULL, "Print the temperature-history ring buffer", cmd_temp);
#endif

int main(void)
{
	LOG_INF("rpi_pico_zephyr_debug starting");

	bool led_ready = false;

	if (led.port != NULL) {
		if (gpio_is_ready_dt(&led)) {
			gpio_pin_configure_dt(&led, GPIO_OUTPUT_INACTIVE);
			led_ready = true;
		} else {
			LOG_WRN("heartbeat LED not ready; continuing without it");
		}
	}

	for (;;) {
		uint16_t raw = next_raw();
		int32_t millicelsius = raw_to_millicelsius(raw);

		LOG_INF("sample %zu: raw=%u temp=%d m°C", sample_index, raw, millicelsius);

		/* --- Deliberate bug ---------------------------------------------
		 * `sample_index` should wrap with `(sample_index + 1) %
		 * HISTORY_LEN`, but it just keeps incrementing. After
		 * HISTORY_LEN samples it walks off the end of `history`.
		 *
		 * In C++ that write is silent undefined behaviour -- unlike
		 * Rust, where indexing is bounds-checked and panics on its own.
		 * The __ASSERT below stands in for that check: with
		 * CONFIG_ASSERT=y it turns the out-of-bounds access into a
		 * deterministic fatal error -- with the failing expression,
		 * file:line, and (via CONFIG_EXCEPTION_STACK_TRACE) a backtrace
		 * -- which is what the walkthrough in README.md drives. Remove
		 * it and the same bug becomes memory corruption you'd have to
		 * hunt by its symptoms; that contrast is itself the lesson.
		 *
		 * Debugging ideas (see README.md):
		 *   - Break on the `history[...]` write and step the last few
		 *     iterations, watching `sample_index` approach the limit
		 *     (`print sample_index` works here -- it's a plain static).
		 *   - Set a watchpoint on `sample_count` and let it run: it
		 *     stops the instant the value changes.
		 *   - Just let it run into the assert and read the backtrace.
		 */
		__ASSERT(sample_index < HISTORY_LEN, "history index %zu out of bounds",
			 sample_index);
		history[sample_index] = millicelsius;
		sample_index = sample_index + 1;
		// The one-line fix (README.md, "Fixing the bug"):
		// sample_index = (sample_index + 1) % HISTORY_LEN;
		sample_count = sample_index;
		/* ---------------------------------------------------------------- */

		if (led_ready) {
			gpio_pin_toggle_dt(&led);
		}
		k_msleep(SAMPLE_PERIOD_MS);
	}

	return 0;
}
```

## src/temp_convert.cpp
```c
#include "temp_convert.hpp"

namespace
{

/* ADC reference voltage in microvolts (the RP2040 samples against 3.3 V). */
constexpr int64_t VREF_UV = 3'300'000;

/* Full scale of the RP2040's 12-bit SAR ADC. */
constexpr int64_t ADC_FULL_SCALE = 4096;

/* Sensor voltage at 27 C, in microvolts (RP2040 datasheet, section 4.9.5). */
constexpr int64_t V_AT_27C_UV = 706'000;

/* Sensor slope: microvolts per degree Celsius. The voltage falls as the die
 * warms; the datasheet gives 1.721 mV/C.
 */
constexpr int64_t UV_PER_DEGREE = 1721;

} // namespace

int32_t raw_to_millicelsius(uint16_t raw)
{
	/* Work in microvolts so the divide doesn't quantise to ~0.58 C steps,
	 * and in int64_t throughout -- both `raw * 3'300'000` and the scaled
	 * offset overflow int32_t.
	 */
	int64_t voltage_uv = static_cast<int64_t>(raw) * VREF_UV / ADC_FULL_SCALE;

	return static_cast<int32_t>(27'000 - (voltage_uv - V_AT_27C_UV) * 1000 / UV_PER_DEGREE);
}
```

## src/temp_convert.hpp
```c
#ifndef APP_TEMP_CONVERT_HPP_
#define APP_TEMP_CONVERT_HPP_

#include <cstdint>

/*
 * Converts a 12-bit reading from the RP2040's onboard temperature sensor into
 * millidegrees Celsius, using the datasheet formula (section 4.9.5):
 *
 *   T = 27 - (V - 0.706) / 0.001721
 *
 * Kept free of Zephyr headers on purpose, so the exact same translation unit
 * compiles both for the RP2040 firmware and for the host-side native_sim test
 * under tests/ -- the C++ analog of the Rust sibling's dependency-free
 * `rp2040_temp` crate.
 */
int32_t raw_to_millicelsius(uint16_t raw);

#endif /* APP_TEMP_CONVERT_HPP_ */
```
