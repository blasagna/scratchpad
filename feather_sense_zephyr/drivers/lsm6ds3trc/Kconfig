## feather_sense_zephyr/drivers/lsm6ds3trc/dts/bindings/sensor/scratchpad,lsm6ds3trc.yaml
```yaml
# Copyright (c) 2026 Bob DiMaiolo
# SPDX-License-Identifier: Apache-2.0

description: |
  LSM6DS3TR-C / LSM6DS33 6-axis IMU on I2C.

  One binding for both parts. Adafruit swapped the LSM6DS33 for the
  pin-compatible LSM6DS3TR-C in January 2024 without changing the board, and
  the two share every register this driver touches; they differ only in
  WHO_AM_I (0x69 and 0x6a respectively), which the driver accepts either of.

  This compatible is defined by this application and by nothing else -- Zephyr
  has no in-tree driver for either part.

compatible: "scratchpad,lsm6ds3trc"

include: [sensor-device.yaml, i2c-device.yaml]

properties:
  irq-gpios:
    type: phandle-array
    description: |
      The chip's INT1 pin, on which the FIFO watermark is signalled. Optional:
      with it absent the driver builds without trigger support and the
      application drains the FIFO on a timer instead. Present is not sufficient
      either -- the Kconfig trigger-mode choice defaults to NONE, so a board
      that wants the interrupt sets both. On the Feather Sense INT1 is P1.11;
      INT2 is not routed, which is why there is no second property here. See
      README.md, "the imu's INT1 line".
```

## feather_sense_zephyr/tests/battery_level/testcase.yaml
```yaml
tests:
  battery_level.average:
    platform_allow:
      - native_sim
    tags:
      - battery_level
  battery_level.deadband:
    platform_allow:
      - native_sim
    tags:
      - battery_level
  battery_level.percent:
    platform_allow:
      - native_sim
    tags:
      - battery_level
  battery_level.band:
    platform_allow:
      - native_sim
    tags:
      - battery_level
```

## feather_sense_zephyr/tests/codec/testcase.yaml
```yaml
tests:
  codec.batch_header:
    platform_allow:
      - native_sim
    tags:
      - codec
  codec.cobs:
    platform_allow:
      - native_sim
    tags:
      - codec
```

## rpi_pico_zephyr_debug/tests/temp_convert/testcase.yaml
```yaml
tests:
  temp_convert.raw_to_millicelsius:
    platform_allow:
      - native_sim
    tags:
      - temp_convert
```
